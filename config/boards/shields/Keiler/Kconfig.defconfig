## config/boards/shields/Keiler/Kconfig.defconfig
```kconfig
if SHIELD_KEILER_LEFT
config ZMK_KEYBOARD_NAME
    default "Keiler"
config ZMK_SPLIT_ROLE_CENTRAL
    default y
endif

if SHIELD_KEILER_LEFT || SHIELD_KEILER_RIGHT
config ZMK_SPLIT
    default y
endif
```
